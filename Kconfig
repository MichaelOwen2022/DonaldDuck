## Kconfig
```kconfig
# Copyright (c) 2022-2023 tangchunhui@coros.com
#
# SPDX-License-Identifier: Apache-2.0

mainmenu "Build Configuration"

config DEBUG
    bool "Build Debug Version"

source "source/src/Kconfig"
```

## configs/x86_miniwave_defconfig
```kconfig
CONFIG_DEBUG=y
CONFIG_LIBRARY=y
CONFIG_LIBRARY_MINIWAVE=y
CONFIG_SAMPLES=y
CONFIG_SAMPLES_MINIWAVE=y
```

## configs/x86_template_defconfig
```kconfig
CONFIG_DEBUG=y
CONFIG_LIBRARY=y
CONFIG_LIBRARY_TEMPLATE=y
CONFIG_LIBRARY_TEMPLATE_SHARED=y
CONFIG_SAMPLES=y
CONFIG_SAMPLES_TEMPLATE=y
```

## source/src/Kconfig
```kconfig
# Copyright (c) 2022-2023 tangchunhui@coros.com
#
# SPDX-License-Identifier: Apache-2.0

source "source/src/library/Kconfig"
source "source/src/samples/Kconfig"
```

## source/src/library/Kconfig
```kconfig
# Copyright (c) 2022-2023 tangchunhui@coros.com
#
# SPDX-License-Identifier: Apache-2.0

menuconfig LIBRARY
    bool "Library Configuration"

if LIBRARY

source "source/src/library/template/Kconfig"
source "source/src/library/miniwave/Kconfig"

endif
```

## source/src/library/miniwave/Kconfig
```kconfig
# Copyright (c) 2022-2023 tangchunhui@coros.com
#
# SPDX-License-Identifier: Apache-2.0

menuconfig LIBRARY_MINIWAVE
    bool "Library MiniWave Configuration"

if LIBRARY_MINIWAVE

config LIBRARY_MINIWAVE_STATIC
    bool "MiniWave Static Library"
    default y

config LIBRARY_MINIWAVE_SHARED
    bool "MiniWave Shared Library"

endif
```

## source/src/library/template/Kconfig
```kconfig
# Copyright (c) 2022-2023 tangchunhui@coros.com
#
# SPDX-License-Identifier: Apache-2.0

menuconfig LIBRARY_TEMPLATE
    bool "Library Template Configuration"

if LIBRARY_TEMPLATE

config LIBRARY_TEMPLATE_STATIC
    bool "Template Static Library"
    default y

config LIBRARY_TEMPLATE_SHARED
    bool "Template Shared Library"

endif
```

## source/src/samples/Kconfig
```kconfig
# Copyright (c) 2022-2023 tangchunhui@coros.com
#
# SPDX-License-Identifier: Apache-2.0

menuconfig SAMPLES
    bool "Samples Configuration"

if SAMPLES

source "source/src/samples/template/Kconfig"
source "source/src/samples/miniwave/Kconfig"

endif
```

## source/src/samples/miniwave/Kconfig
```kconfig
# Copyright (c) 2022-2023 tangchunhui@coros.com
#
# SPDX-License-Identifier: Apache-2.0

menuconfig SAMPLES_MINIWAVE
    bool "Samples MiniWave Configuration"

if SAMPLES_MINIWAVE

endif
```

## source/src/samples/template/Kconfig
```kconfig
# Copyright (c) 2022-2023 tangchunhui@coros.com
#
# SPDX-License-Identifier: Apache-2.0

menuconfig SAMPLES_TEMPLATE
    bool "Samples Template Configuration"

if SAMPLES_TEMPLATE

config SAMPLES_TEMPLATE_WELCOME
    string "Welcome"
    default "Welcome to template samples"

endif
```
